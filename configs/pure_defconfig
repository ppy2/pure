## configs/pure_defconfig
```kconfig
BR2_arm=y
BR2_cortex_a8=y
BR2_TARGET_GENERIC_HOSTNAME="pure"
BR2_TARGET_GENERIC_ISSUE="Welcome to PURE OS"
BR2_TARGET_GENERIC_ROOT_PASSWD="root"
BR2_ROOTFS_OVERLAY="../board/pure/rootfs-overlay"
BR2_ROOTFS_POST_BUILD_SCRIPT="../board/pure/post-build.sh"
BR2_ROOTFS_POST_IMAGE_SCRIPT="support/scripts/genimage.sh"
BR2_ROOTFS_POST_SCRIPT_ARGS="-c ../board/pure/genimage.cfg"

BR2_TOOLCHAIN=y
BR2_TOOLCHAIN_USES_GLIBC=y
BR2_TOOLCHAIN_EXTERNAL=y
BR2_TOOLCHAIN_EXTERNAL_ARM_ARM=y
BR2_TOOLCHAIN_EXTERNAL_DOWNLOAD=y
BR2_TOOLCHAIN_EXTERNAL_GLIBC=y
BR2_PACKAGE_HAS_TOOLCHAIN_EXTERNAL=y
BR2_PACKAGE_PROVIDES_TOOLCHAIN_EXTERNAL="toolchain-external-arm-arm"
BR2_TOOLCHAIN_EXTERNAL_PREFIX="arm-none-linux-gnueabihf"
BR2_TOOLCHAIN_EXTERNAL_BOOTLIN_ARCH_SUPPORTS=y

BR2_LINUX_KERNEL=y
BR2_LINUX_KERNEL_CUSTOM_GIT=y
BR2_LINUX_KERNEL_CUSTOM_REPO_URL="https://github.com/ppy2/kernel_botic7.git"
BR2_LINUX_KERNEL_CUSTOM_REPO_VERSION="main"
BR2_LINUX_KERNEL_VERSION="main"
BR2_LINUX_KERNEL_PATCH=""
BR2_LINUX_KERNEL_USE_CUSTOM_CONFIG=y
BR2_LINUX_KERNEL_CUSTOM_CONFIG_FILE="../board/pure/linux.config"
BR2_LINUX_KERNEL_ZIMAGE=y
BR2_LINUX_KERNEL_GZIP=y
BR2_LINUX_KERNEL_DTS_SUPPORT=y
BR2_LINUX_KERNEL_INTREE_DTS_NAME="am335x-boneblack am335x-boneblack-botic"
BR2_LINUX_KERNEL_CUSTOM_DTS_PATH=""
BR2_LINUX_KERNEL_NEEDS_HOST_OPENSSL=y

BR2_PACKAGE_BUSYBOX_CONFIG="../board/pure/busybox.config"
BR2_PACKAGE_DBUS=y
BR2_PACKAGE_LINUX_TOOLS_GPIO=y
BR2_PACKAGE_ALSA_UTILS=y
BR2_PACKAGE_ALSA_UTILS_ALSACONF=y
BR2_PACKAGE_ALSA_UTILS_APLAY=y
BR2_PACKAGE_ALSA_UTILS_SPEAKER_TEST=y
BR2_PACKAGE_AVAHI=y
BR2_PACKAGE_AVAHI_AUTOIPD=y
BR2_PACKAGE_AVAHI_DAEMON=y
BR2_PACKAGE_MPD=y
BR2_PACKAGE_MPD_DSD=y
BR2_PACKAGE_MPD_FFMPEG=y
BR2_PACKAGE_MPD_FLAC=y
BR2_PACKAGE_MPD_MAD=y
BR2_PACKAGE_MPD_WAVPACK=y
BR2_PACKAGE_MPD_ALSA=y
BR2_PACKAGE_MPD_TCP=y
BR2_PACKAGE_MPD_CURL=y
BR2_PACKAGE_SQUEEZELITE=y
BR2_PACKAGE_SQUEEZELITE_FFMPEG=y
BR2_PACKAGE_SQUEEZELITE_DSD=y
BR2_PACKAGE_UPMPDCLI=y
BR2_PACKAGE_SHAIRPORT_SYNC=y
BR2_PACKAGE_SHAIRPORT_SYNC_DBUS=y
BR2_PACKAGE_PHP=y
BR2_PACKAGE_PHP_SAPI_CGI=y
BR2_PACKAGE_HTOP=y
BR2_PACKAGE_DROPBEAR=y
BR2_PACKAGE_DROPBEAR_CLIENT=n
BR2_PACKAGE_DROPBEAR_DISABLE_REVERSEDNS=y
BR2_PACKAGE_DROPBEAR_SMALL=y
BR2_PACKAGE_OPENSSH=y
BR2_PACKAGE_OPENSSH_CLIENT=y
BR2_PACKAGE_OPENSSH_SERVER=n
BR2_PACKAGE_OPENSSH_KEY_UTILS=n
BR2_PACKAGE_SSHFS=y
BR2_PACKAGE_DHCPCD=y
BR2_PACKAGE_MC=y
BR2_PACKAGE_ETHTOOL=y
BR2_PACKAGE_ETHTOOL_PRETTY_PRINT=y
BR2_PACKAGE_RSYNC=y
BR2_PACKAGE_E2FSPROGS=y
BR2_PACKAGE_DOSFSTOOLS=y
BR2_PACKAGE_FUSE_OVERLAYFS=y
BR2_PACKAGE_E2TOOLS=y
BR2_PACKAGE_HOST_DOSFSTOOLS=y
BR2_PACKAGE_HOST_GENIMAGE=y
BR2_PACKAGE_HOST_MTOOLS=y
BR2_PACKAGE_HOST_UBOOT_TOOLS=y
BR2_PACKAGE_HOST_UBOOT_TOOLS_FIT_SUPPORT=y

BR2_TARGET_ROOTFS_EXT2=y
BR2_TARGET_ROOTFS_EXT2_4=y
BR2_TARGET_ROOTFS_EXT2_LABEL=""
BR2_TARGET_ROOTFS_EXT2_SIZE="512M"
BR2_ROOTFS_POST_IMAGE_SCRIPT="../board/pure/genimage.sh"
BR2_TARGET_UBOOT=y
BR2_TARGET_UBOOT_PATCH="../board/pure/patches/uboot/"
BR2_TARGET_UBOOT_USE_CUSTOM_CONFIG=y
BR2_TARGET_UBOOT_CUSTOM_CONFIG_FILE="../board/pure/uboot.config"
BR2_TARGET_UBOOT_NEEDS_DTC=y
# BR2_TARGET_UBOOT_FORMAT_BIN is not set
BR2_TARGET_UBOOT_FORMAT_IMG=y
BR2_TARGET_UBOOT_SPL=y
BR2_TARGET_UBOOT_SPL_NAME="MLO"
```
